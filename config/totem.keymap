/* source key position labels */
#include "zmk-helpers/key-labels/totem.h"

#define X_LB    &kp LB5
#define X_RB    &kp RB5

/* activate bluetooth */
#define CONFIG_WIRELESS

/* source the main keymap */
#include "base.keymap"
